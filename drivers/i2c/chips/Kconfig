## drivers/i2c/chips/Kconfig
```kconfig
#
# Thecus I2C chip drivers configuration
#

menu "Thecus I2C Chip support"

config SENSORS_N16000_IO
	tristate "Thecus N16000 MB I/O operation"
	depends on I2C
	help
	  If you say yes here you get support for the
	  Thecus N16000 MB io operation.

	  This driver can also be built as a module. If so, the module
	  will be called thecus_io.

config SENSORS_N8900_IO
	tristate "Thecus N8900 MB I/O operation"
	depends on I2C
	help
	  If you say yes here you get support for the
	  Thecus N8900 MB io operation.

	  This driver can also be built as a module. If so, the module
	  will be called thecus_io.

config SENSORS_N2800_IO
	tristate "Thecus N2800 MB I/O operation"
	depends on I2C
	help
	  If you say yes here you get support for the
	  Thecus N2800 MB io operation.

	  This driver can also be built as a module. If so, the module
	  will be called thecus_io.

config SENSORS_N7700PRO_IO
	tristate "Thecus N7700PRO MB I/O operation"
	depends on I2C
	help
	  If you say yes here you get support for the
	  Thecus N7700PRO MB io operation.

	  This driver can also be built as a module. If so, the module
	  will be called thecus_io.

config SENSORS_N5810_IO
        tristate "Thecus N5810 MB I/O operation"
        depends on I2C
        help
          If you say yes here you get support for the
          Thecus N5810 MB io operation.

          This driver can also be built as a module. If so, the module
          will be called thecus_io.

config SENSORS_N8950_IO
        tristate "Thecus N8950 MB I/O operation"
        depends on I2C
        help
          If you say yes here you get support for the
          Thecus N8910 MB io operation.

          This driver can also be built as a module. If so, the module
          will be called thecus_io.

config SENSORS_NXXXX_IO
        tristate "Thecus NXXXX MB I/O operation"
        select IRQ_DOMAIN
        help
          If you say yes here you get support for the
          Thecus NXXXX MB io operation.

          This driver can also be built as a module. If so, the module
          will be called thecus_io.

endmenu
```

## drivers/net/ethernet/tehuti/Kconfig
```kconfig
#
# Tehuti network device configuration
#

config NET_VENDOR_TEHUTI
	bool "Tehuti devices"
	default y
	depends on PCI
	---help---
	  If you have a network (Ethernet) card belonging to this class, say Y
	  and read the Ethernet-HOWTO, available from
	  <http://www.tldp.org/docs.html#howto>.

	  Note that the answer to this question doesn't directly affect the
	  kernel: saying N will just cause the configurator to skip all
	  the questions about Tehuti cards. If you say Y, you will be asked for
	  your specific card in the following questions.

if NET_VENDOR_TEHUTI

config TEHUTI_C10GT
	tristate "Tehuti Networks 10G SFP+ Ethernet NIC"
	depends on PCI
	---help---
	  Tehuti Networks 10G SFP+ Ethernet NIC

config TN4011_10GBASET
	tristate "Tehuti Networks 10G base-T Ethernet NIC"
	depends on PCI
	---help---
	  Tehuti Networks 10G base-T Ethernet NIC

config TN4022_DXE810S
	tristate "Tehuti Networks for DLINK DXE810S Ethernet NIC"
	depends on PCI
	---help---
	  Tehuti Networks for DLINK DXE810S Ethernet NIC

endif # NET_VENDOR_TEHUTI
```
